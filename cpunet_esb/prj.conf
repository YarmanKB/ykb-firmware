## CMakeLists.txt
```
cmake_minimum_required(VERSION 3.20.0)

find_package(Zephyr REQUIRED HINTS $ENV{ZEPHYR_BASE})

project(YKBFirmware LANGUAGES C)

target_sources(app PRIVATE src/main.c)
```

## prj.conf
```kconfig
CONFIG_LIB_YKB_ESB=y
# BT is absent; override the "default y if BT" so ESB still uses MPSL timeslots.
# CONFIG_LIB_YKB_ESB_MPSL=y

CONFIG_RING_BUFFER=y

CONFIG_DYNAMIC_INTERRUPTS=y
CONFIG_DYNAMIC_DIRECT_INTERRUPTS=y

CONFIG_ESB=y
CONFIG_ESB_DYNAMIC_INTERRUPTS=y

# CONFIG_MPSL=y
# CONFIG_MPSL_TIMESLOT_SESSION_COUNT=1

CONFIG_IPC_SERVICE=y
CONFIG_MBOX=y

CONFIG_SYSTEM_WORKQUEUE_STACK_SIZE=2048
CONFIG_HEAP_MEM_POOL_SIZE=4096
CONFIG_ISR_STACK_SIZE=1024
CONFIG_IDLE_STACK_SIZE=256
CONFIG_MAIN_STACK_SIZE=2048

CONFIG_NRF_RPC=y
CONFIG_NRF_RPC_CBOR=y
CONFIG_THREAD_CUSTOM_DATA=y
CONFIG_NRF_RPC_THREAD_POOL_SIZE=1
CONFIG_NRF_RPC_THREAD_STACK_SIZE=2048

CONFIG_LOG=y
```

## src/main.c
```c
#include <zephyr/kernel.h>
#include <zephyr/logging/log.h>
#include <zephyr/types.h>

#include <lib/ykb_esb.h>

LOG_MODULE_REGISTER(main, LOG_LEVEL_INF);

int main(void) {
    int err = ykb_esb_rpc_start();
    if (err) {
        LOG_ERR("ykb_esb_rpc_start failed: %d", err);
    }

    while (true) {
        k_sleep(K_FOREVER);
    }
}
```
