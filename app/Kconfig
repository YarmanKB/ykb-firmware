## subsys/kb_settings/Kconfig
```kconfig
menuconfig KB_SETTINGS
    bool "Enable KB Settings subsystem"
    depends on KB_HANDLER
    select SETTINGS

if KB_SETTINGS

    module = KB_SETTINGS
    module-str = kb_settings
    source "subsys/logging/Kconfig.template.log_config"

    ZEPHYR_USER := zephyr,user
    KB_HANDLER_PATH := $(dt_nodelabel_path,kb_handler)

    config KB_SETTINGS_KEY_COUNT
        int
        default $(dt_node_int_prop_int,/$(ZEPHYR_USER),kb-handler-key-count)

    config KB_SETTINGS_KEY_COUNT_SLAVE
        int
        depends on $(dt_node_has_prop,/$(ZEPHYR_USER),kb-handler-key-count-slave)
        default $(dt_node_int_prop_int,/$(ZEPHYR_USER),kb-handler-key-count-slave)

    config KB_SETTINGS_INIT_PRIORITY
        int "Init priority"
        default 140

    config KB_SETTINGS_FN_SHORTCUTS_MAX
        int "Maximum amount of runtime-configurable FN shortcuts"
        default 16

endif # KB_SETTINGS
```

## subsys/splitlink/Kconfig
```kconfig
menuconfig SPLITLINK
    bool "Enable Splitlink"

if SPLITLINK

    choice SPLITLINK_TRANSPORT
        prompt "Splitlink transport"
        default SPLITLINK_BT

        config SPLITLINK_BT
            bool "Bluetooth"
            select BT
            select BT_CENTRAL if SPLITLINK_BT_CENTRAL
            select BT_PERIPHERAL if SPLITLINK_BT_PERIPHERAL
            select BT_GATT_CLIENT if SPLITLINK_BT_CENTRAL

        config SPLITLINK_YKB_ESB
            bool "ESB"
            select LIB_YKB_ESB

    endchoice

    config SPLITLINK_SYNC
        bool

    config SPLITLINK_SYNC_MASTER
        bool
        depends on SPLITLINK_SYNC

    config SPLITLINK_SYNC_SLAVE
        bool
        depends on SPLITLINK_SYNC

    module = SPLITLINK
    module-str = splitlink
    source "subsys/logging/Kconfig.template.log_config"

    rsource "Kconfig.sync"
    rsource "Kconfig.bt"
    rsource "Kconfig.ykb_esb"

endif # SPLITLINK
```

## subsys/splitlink/Kconfig.bt
```kconfig
if SPLITLINK_BT

choice SPLITLINK_BT_ROLE
    prompt "Splitlink Bluetooth role"
    default SPLITLINK_BT_CENTRAL if SPLITLINK_SYNC_MASTER
    default SPLITLINK_BT_PERIPHERAL if SPLITLINK_SYNC_SLAVE

config SPLITLINK_BT_CENTRAL
    bool "Central"

config SPLITLINK_BT_PERIPHERAL
    bool "Peripheral"

endchoice

config SPLITLINK_BT_INIT_PRIORITY
    int "Splitlink Bluetooth init priority"
    default APPLICATION_INIT_PRIORITY

config SPLITLINK_BT_PACKET_LENGTH
    int "Splitlink Bluetooth packet length"
    default 72
    range 1 244

config SPLITLINK_BT_RX_QUEUE_DEPTH
    int "Splitlink Bluetooth RX queue depth"
    default 8
    range 1 32

configdefault BT_MAX_CONN
    default 2 if BT_CONNECT
    default 1

configdefault BT_MAX_PAIRED
    default 2 if BT_CONNECT
    default 1

configdefault BT_L2CAP_TX_MTU
    default 77

configdefault BT_BUF_ACL_RX_SIZE
    default 81

configdefault BT_BUF_ACL_TX_SIZE
    default 81

configdefault BT_ATT_TX_COUNT
    default 10

configdefault BT_PERIPHERAL_PREF_MIN_INT
    default 6

configdefault BT_PERIPHERAL_PREF_MAX_INT
    default 6

configdefault BT_PERIPHERAL_PREF_LATENCY
    default 0

configdefault BT_PERIPHERAL_PREF_TIMEOUT
    default 400

configdefault BT_GATT_AUTO_UPDATE_MTU
    default y

configdefault BT_AUTO_DATA_LEN_UPDATE
    default y

configdefault BT_USER_PHY_UPDATE
    default y

configdefault BT_USER_DATA_LEN_UPDATE
    default y

endif # SPLITLINK_BT
```

## subsys/splitlink/Kconfig.sync
```kconfig
if SPLITLINK_SYNC

    choice SPLITLINK_SYNC_IMPL
        prompt "Splitlink sync implementation"

        config SPLITLINK_SYNC_IMPL_YKB_PROTO
            bool "Splitlink sync over YKB protocol"

    endchoice

    if SPLITLINK_SYNC_IMPL_YKB_PROTO

        config SPLITLINK_OUT_OF_ORDER_TRACK
            bool "Enable out-of-order feature of YKB protocol"
            default y if SPLITLINK_BT
            default n

        config SPLITLINK_BITMAP_LENGTH
            int "Bitmap length for out-of-order feature"
            depends on SPLITLINK_OUT_OF_ORDER_TRACK
            default 32
            range 1 256

        config SPLITLINK_BENCHMARK
            bool "Enable Splitlink RTT benchmark"
            default n

        config SPLITLINK_BENCHMARK_INTERVAL_MS
            int "Splitlink RTT benchmark interval in ms"
            depends on SPLITLINK_BENCHMARK
            default 1000
            range 1 60000

        config SPLITLINK_BENCHMARK_PAYLOAD_SIZE
            int "Splitlink RTT benchmark payload size"
            depends on SPLITLINK_BENCHMARK
            default 16
            range 0 48

    endif # SPLITLINK_SYNC_IMPL_YKB_PROTO

endif # SPLITLINK_SYNC
```

## subsys/splitlink/Kconfig.ykb_esb
```kconfig
if SPLITLINK_YKB_ESB

    choice SPLITLINK_YKB_ESB_ROLE
        prompt "Splitlink over ESB role"
        default SPLITLINK_YKB_ESB_PRX if SPLITLINK_SYNC_MASTER
        default SPLITLINK_YKB_ESB_PTX if SPLITLINK_SYNC_SLAVE

        config SPLITLINK_YKB_ESB_PTX
            bool "Enable Splitlink over ESB as PTX"

        config SPLITLINK_YKB_ESB_PRX
            bool "Enable Splitlink over ESB as PRX"

    endchoice # SPLITLINK_YKB_ESB_ROLE

    config SPLITLINK_YKB_ESB_ALIVE_TIMEOUT
        int "Time after last incoming packet after which disconnect is triggered (ms)"
        default 200
        range 2 1000

    config SPLITLINK_YKB_ESB_INIT_PRIORITY
        int "Init priority"
        default APPLICATION_INIT_PRIORITY

    if SPLITLINK_YKB_ESB_PTX

        config SPLITLINK_YKB_ESB_PTX_ALIVE_DELAY
            int "Time between sending 'Alive' packets (ms)"
            default 50
            range 1 SPLITLINK_YKB_ESB_ALIVE_TIMEOUT

    endif # SPLITLINK_YKB_ESB_PTX

endif # SPLITLINK_YKB_ESB
```

## subsys/usb_connect/Kconfig
```kconfig
menuconfig USB_CONNECT
    bool "Enable USB Connect subsystem"
    depends on DT_HAS_ZEPHYR_HID_DEVICE_ENABLED
    select HWINFO
    select USB_DEVICE_STACK_NEXT
    select USBD_HID_SUPPORT

if USB_CONNECT

    module = USB_CONNECT
    module-str = usb_connect
    source "subsys/logging/Kconfig.template.log_config"

    config USB_CONNECT_SELF_POWERED
        bool "Enable USB device Self-powered attribute"
        default y

    config USB_CONNECT_REMOTE_WAKEUP
        bool "Enable remote wakeup feature"
        default y

    config USB_CONNECT_VID
        hex "USB device vendor ID"
        default 0x6969
    
    config USB_CONNECT_PID
        hex "USB device product ID"

    config USB_CONNECT_MANUFACTURER
        string "USB device manufacturer string"
        default "YarmanKB"

    config USB_CONNECT_PRODUCT
        string "USB device product string"

    config USB_CONNECT_MAX_POWER
        int "USB Max Power value"
        range 1 250
        default 250

    config USB_CONNECT_20_EXTENSION_DESC
        bool "Enable USB2.0 Extension descriptor"

    config USB_CONNECT_INIT_PRIORITY
        int "Init priority"
        default APPLICATION_INIT_PRIORITY

    Z_HID_DEV := zephyr,hid-device

    config USB_CONNECT_KBD
        bool "Enable keyboard HID device over USB"
        depends on $(dt_nodelabel_enabled_with_compat,hid_kbd,$(Z_HID_DEV))
        default y

    config USB_CONNECT_MOUSE
        bool "Enable mouse HID device over USB"
        depends on $(dt_nodelabel_enabled_with_compat,hid_mouse,$(Z_HID_DEV))
        default y
    
    config USB_CONNECT_VENDOR
        bool "Enable vendor HID device over USB (YKBConfigurator communication)"
        depends on $(dt_nodelabel_enabled_with_compat,hid_vendor,$(Z_HID_DEV))
        default y
        select VENDOR_HID

    if USB_CONNECT_VENDOR

        HID_DEV_PATH := $(dt_nodelabel_path,hid_vendor)

        config USB_CONNECT_MAX_VENDOR_IN_REPORT_SIZE
            int "In report packet size of vendor HID"
            range 7 $(dt_node_int_prop_int,$(HID_DEV_PATH),in-report-size)
            default $(dt_node_int_prop_int,$(HID_DEV_PATH),in-report-size)

        config USB_CONNECT_MAX_VENDOR_OUT_REPORT_SIZE
            int "Out report packet size of vendor HID"
            range 7 $(dt_node_int_prop_int,$(HID_DEV_PATH),out-report-size)
            default $(dt_node_int_prop_int,$(HID_DEV_PATH),out-report-size)

        config USB_CONNECT_VENDOR_THREAD_PRIORITY
            int "Vendor thread priority"
            default 12

        config USB_CONNECT_VENDOR_THREAD_STACK_SIZE
            int "Vendor thread stack size"
            default 1024

        config USB_CONNECT_VENDOR_MSGQ_SIZE
            int "Vendor thread ring buffer size"
            default 8

    endif # USB_CONNECT_VENDOR

endif # USB_CONNECT
```

## subsys/vendor_hid/Kconfig
```kconfig
config VENDOR_HID
    bool "Enable Vendor HID subsystem/library for communicating with host via vendor HID device"

if VENDOR_HID

    module = VENDOR_HID
    module-str = vendor_hid
    source "subsys/logging/Kconfig.template.log_config"

    choice VENDOR_HID_PROTOCOL_IMPL
        prompt "Vendor HID protocol implementation"
        default VENDOR_HID_PROTOCOL_YKB

        config VENDOR_HID_PROTOCOL_YKB
            bool "Use YKB protocol"

    endchoice # VENDOR_HID_PROTOCOL_IMPL

endif # VENDOR_HID
```
