## app/Kconfig
```kconfig
menu "Zephyr"
source "Kconfig.zephyr"
endmenu

comment "Application defaults"

config KB_HANDLER
	default y

config KB_SETTINGS
	default y

config USB_CONNECT
	default y if !SPLITLINK_SYNC_SLAVE

config BT_CONNECT
	default y if !SPLITLINK_SYNC_SLAVE

config YKB_BATTSENSE
	default y

config YKB_BACKLIGHT
	default y

module = APP
module-str = APP
source "subsys/logging/Kconfig.template.log_config"

# MCUboot sysbuild supplies this value even when the application does not
# enable Zephyr's DFU image manager.
config MCUBOOT_UPDATE_FOOTER_SIZE
	hex "Estimated MCUboot update footer size"
```

## app/Kconfig.sysbuild
```kconfig
if SUPPORT_NETCORE

config SUPPORT_NETCORE_CPUNET_MPSL
	bool

config SUPPORT_NETCORE_CPUNET_ESB
    bool

choice NETCORE
	depends on !EXTERNAL_CONFIGURED_NETCORE

config NETCORE_CPUNET_MPSL
	bool "cpunet_mpsl"
	depends on SUPPORT_NETCORE_CPUNET_MPSL
	help
	  Build the project's custom MPSL-based network core image from
	  `cpunet_mpsl/`.

config NETCORE_CPUNET_ESB
    bool "cpunet_esb"
    depends on SUPPORT_NETCORE_CPUNET_ESB
    help
      Build the project's custom ESB-based network core image from
      `cpunet_esb/`.

endchoice

if !NETCORE_NONE

config NETCORE_IMAGE_NAME
	default "cpunet_mpsl" if NETCORE_CPUNET_MPSL
    default "cpunet_esb" if NETCORE_CPUNET_ESB

config NETCORE_IMAGE_PATH
	default "$(APP_DIR)/../cpunet_mpsl" if NETCORE_CPUNET_MPSL
    default "$(APP_DIR)/../cpunet_esb" if NETCORE_CPUNET_ESB

endif # !NETCORE_NONE

endif # SUPPORT_NETCORE

source "share/sysbuild/Kconfig"
```

## boards/ykb/skadi/Kconfig.defconfig
```kconfig
if LOG

    config SERIAL
        default y

    config CONSOLE
        default y

    config UART_CONSOLE
        default y

endif # LOG

if BOARD_SKADI_NRF5340_CPUAPP_LEFT || BOARD_SKADI_NRF5340_CPUAPP_RIGHT

    DT_CHOSEN_Z_CODE_PARTITION := zephyr,code-partition
    DT_CHOSEN_Z_SRAM_PARTITION := zephyr,sram-secure-partition


    if USB_DEVICE_STACK

        config USB_DEVICE_VID
            default 0x6969

        config USB_DEVICE_PID
            default 0x0001

    endif # USB_DEVICE_STACK

    if KB_HANDLER

        choice KB_HANDLER_IMPL
            default KB_HANDLER_SPLITLINK_MASTER if BOARD_SKADI_NRF5340_CPUAPP_LEFT
            default KB_HANDLER_SPLITLINK_SLAVE if BOARD_SKADI_NRF5340_CPUAPP_RIGHT
        endchoice

    endif # KB_HANDLER

    if USB_CONNECT

        config USB_CONNECT_PID
            default 0x0001

        config USB_CONNECT_PRODUCT
            default "YKB Skadi"

        config USB_CONNECT_MAX_POWER
            default 250

    endif # USB_CONNECT

    if BT_CONNECT

        config BT_MAX_CONN
            default 2 if SPLITLINK_BT_CENTRAL
            default 1

        config BT_HIDS_MAX_CLIENT_COUNT
            default 1

        config BT_MAX_PAIRED
            default 2

        config BT_DEVICE_NAME
            default "YKB Skadi"

        config BT_DIS_PNP_PID
            default 0x0001

        config BT_DIS_PNP_VER
            default 0x0001

    endif # BT_CONNECT

    if BOARD_SKADI_NRF5340_CPUAPP && TRUSTED_EXECUTION_SECURE

        config FLASH_LOAD_SIZE
            default $(dt_chosen_reg_size_hex,$(DT_CHOSEN_Z_CODE_PARTITION))

        config SRAM_SIZE
            default $(dt_chosen_reg_size_int,$(DT_CHOSEN_Z_SRAM_PARTITION),0,K)

    endif # BOARD_SKADI_NRF5340_CPUAPP && TRUSTED_EXECUTION_SECURE

    config BT_HCI_IPC
        default y if BT

    config HEAP_MEM_POOL_ADD_SIZE_BOARD
        int
        default 4096 if BT_HCI_IPC

    config NRF_RPC_THREAD_STACK_SIZE
        int
        default 4096 if LIB_YKB_ESB

endif # BOARD_SKADI_NRF5340_CPUAPP_LEFT || BOARD_SKADI_NRF5340_CPUAPP_RIGHT
```

## boards/ykb/skadi/Kconfig.sysbuild
```kconfig
config YKB_BUILD_SPLIT_HALVES
  bool "Build both split halves (left/right)"
  default y

if SUPPORT_NETCORE

config SUPPORT_NETCORE_CPUNET_MPSL
	default y

config SUPPORT_NETCORE_CPUNET_ESB
    default y

config SUPPORT_NETCORE_HCI_IPC
	default y

choice NETCORE
	default NETCORE_HCI_IPC if BOARD_SKADI_NRF5340_CPUAPP_LEFT || BOARD_SKADI_NRF5340_CPUAPP_RIGHT
endchoice

endif # SUPPORT_NETCORE
```

## drivers/Kconfig
```kconfig
menu "Drivers"
    rsource "kscan/Kconfig"
    rsource "mux/Kconfig"
endmenu

menu "Custom Zephyr Drivers"
    rsource "charger/Kconfig"
    rsource "fuel_gauge/Kconfig"
endmenu
```

## drivers/kscan/Kconfig
```kconfig
menuconfig KSCAN
    bool "Enable KScan driver"
    select ADC

if KSCAN

    module = KSCAN
    module-str = kscan
    source "subsys/logging/Kconfig.template.log_config"

    rsource "Kconfig.muxes"

endif # KSCAN
```

## drivers/kscan/Kconfig.channels
```kconfig
config KSCAN_CHANNELS
    bool "Enable KScan driver for polling with channels"
    default y
    depends on DT_HAS_KSCAN_CHANNELS_ENABLED

if KSCAN_CHANNELS

    config KSCAN_CHANNELS_THREAD_STACK_SIZE
        int "KScan Channels thread stack size (each channel)"
        default 1024

    config KSCAN_CHANNELS_THREAD_PRIORITY
        int "KScan Channels thread priority (each channel)"
        default 4

endif # KSCAN_CHANNELS
```

## drivers/kscan/Kconfig.enables
```kconfig
config KSCAN_ENABLES
    bool "Enable KScan driver for polling with enable pins"
    depends on DT_HAS_KSCAN_ENABLES_ENABLED
    default y
    select GPIO

if KSCAN_ENABLES

    config KSCAN_ENABLES_THREAD_STACK_SIZE
        int "KScan Enables thread stack size"
        default 1024

    config KSCAN_ENABLES_THREAD_PRIORITY
        int "KScan Enables thread priority"
        default 4

endif # KSCAN_ENABLES
```

## drivers/kscan/Kconfig.muxes
```kconfig
config KSCAN_MUXES
    bool "Enable KScan driver for polling with multiplexers"
    depends on DT_HAS_KSCAN_MUXES_ENABLED
    default y
    select MUX

if KSCAN_MUXES

    config KSCAN_MUXES_MUX_TOGGLE
        bool "Enable/disable multiplexers on each scan"
        default n

    config KSCAN_MUXES_PARALLEL_ADC_READS
        bool "Read all mux ADC channels in one ADC sequence"
        default y
        help
          Read the active channel from every mux with one multi-channel ADC
          sequence. This is faster, but on nRF SAADC hardware oversampling is
          only supported for single-channel sequences, so this mode disables
          sequence oversampling when multiple ADC channels are used.

endif # KSCAN_MUXES
```

## drivers/splitlink/Kconfig
```kconfig
menuconfig SPLITLINK
    bool "Enable Splitlink"

if SPLITLINK

    module = SPLITLINK
    module-str = splitlink
    source "subsys/logging/Kconfig.template.log_config"

    rsource "Kconfig.bt"
    rsource "Kconfig.ykb_esb"

endif # SPLITLINK
```

## drivers/splitlink/Kconfig.bt
```kconfig
menuconfig SPLITLINK_BT
    bool "Enable Splitlink over Bluetooth"
    select BT
    select BT_CENTRAL if SPLITLINK_BT_CENTRAL
    select BT_PERIPHERAL if SPLITLINK_BT_PERIPHERAL
    select BT_GATT_CLIENT if SPLITLINK_BT_CENTRAL
    depends on (DT_HAS_SPLITLINK_BT_CENTRAL_ENABLED || DT_HAS_SPLITLINK_BT_PERIPHERAL_ENABLED)
    default y

if SPLITLINK_BT

config SPLITLINK_BT_CENTRAL
    bool
    default y if DT_HAS_SPLITLINK_BT_CENTRAL_ENABLED

config SPLITLINK_BT_PERIPHERAL
    bool
    default y if DT_HAS_SPLITLINK_BT_PERIPHERAL_ENABLED

config SPLITLINK_BT_INIT_PRIORITY
    int "Splitlink Bluetooth init priority"
    default APPLICATION_INIT_PRIORITY

config SPLITLINK_BT_PACKET_LENGTH
    int "Splitlink Bluetooth packet length"
    default 72
    range 1 244

config SPLITLINK_BT_RX_QUEUE_DEPTH
    int "Splitlink Bluetooth RX queue depth"
    default 8
    range 1 32

configdefault BT_MAX_CONN
    default 2 if BT_CONNECT
    default 1

configdefault BT_MAX_PAIRED
    default 2 if BT_CONNECT
    default 1

configdefault BT_L2CAP_TX_MTU
    default 77

configdefault BT_BUF_ACL_RX_SIZE
    default 81

configdefault BT_BUF_ACL_TX_SIZE
    default 81

configdefault BT_ATT_TX_COUNT
    default 10

configdefault BT_PERIPHERAL_PREF_MIN_INT
    default 6

configdefault BT_PERIPHERAL_PREF_MAX_INT
    default 6

configdefault BT_PERIPHERAL_PREF_LATENCY
    default 0

configdefault BT_PERIPHERAL_PREF_TIMEOUT
    default 400

configdefault BT_GATT_AUTO_UPDATE_MTU
    default y

configdefault BT_AUTO_DATA_LEN_UPDATE
    default y

configdefault BT_USER_PHY_UPDATE
    default y

configdefault BT_USER_DATA_LEN_UPDATE
    default y

endif # SPLITLINK_BT
```

## dts/bindings/splitlink/splitlink-bt-central.yaml
```yaml
title: Splitlink over Bluetooth driver (central role)

description: >
  A binding for Splitlink over a custom Bluetooth GATT transport, acting as the
  central/client side of the link.

compatible: "splitlink-bt-central"

include: splitlink-bt.yaml
```

## dts/bindings/splitlink/splitlink-bt-peripheral.yaml
```yaml
title: Splitlink over Bluetooth driver (peripheral role)

description: >
  A binding for Splitlink over a custom Bluetooth GATT transport, acting as the
  peripheral/server side of the link.

compatible: "splitlink-bt-peripheral"

include: splitlink-bt.yaml
```

## lib/ykb_timeslot/Kconfig
```kconfig
menuconfig LIB_YKB_TIMESLOT
    bool "Enable YKB timeslot library for concurrent BT + ESB"
    depends on SOC_SERIES_NRF52X || SOC_NRF5340_CPUNET

if LIB_YKB_TIMESLOT

    module = YKB_TIMESLOT
    module-str = ykb_timeslot
    source "subsys/logging/Kconfig.template.log_config"

    config LIB_YKB_TIMESLOT_STACK_SIZE
        int "MPSL non-preemptible thread stack size"
        default 1024
        help
          Stack size for the cooperative thread that serialises MPSL timeslot
          API calls (session open/close and timeslot requests).  This thread
          only calls a handful of MPSL functions and does not need a large
          stack; 1024 bytes is sufficient.

endif # LIB_YKB_TIMESLOT
```

## subsys/Kconfig
```kconfig
menu "YKB Subsystems"

    rsource "bt_connect/Kconfig"
    rsource "kb_settings/Kconfig"
    rsource "splitlink/Kconfig"
    rsource "vendor_hid/Kconfig"
    rsource "ykb_battsense/Kconfig"
    rsource "usb_connect/Kconfig"
    rsource "kb_handler/Kconfig"
    rsource "ykb_backlight/Kconfig"
    rsource "ykb_metrics/Kconfig"
    rsource "ykb_power/Kconfig"

endmenu
```

## subsys/bt_connect/Kconfig
```kconfig
menuconfig BT_CONNECT
    bool "Enable BT Connect subsystem"
    select BT
    select BT_SMP
    select BT_PERIPHERAL
    select BT_HIDS
    select BT_CONN_CTX
    select BT_DIS
    select BT_DIS_MANUF_NAME
    select BT_DIS_PNP
    select SETTINGS
    select BT_SETTINGS

if BT_CONNECT

    module = BT_CONNECT
    module-str = bt_connect
    source "subsys/logging/Kconfig.template.log_config"

    config BT_CONNECT_INIT_PRIORITY
        int "Bluetooth connect init priority"
        default 90

    config BT_CONNECT_REPORT_MAP_MAX_SIZE
        int "Maximum assembled BLE HID report map size"
        default 256

    config BT_CONNECT_MAX_VENDOR_IN_REPORT_SIZE
        int "Vendor input report packet size"
        range 7 64
        default 64

    config BT_CONNECT_MAX_VENDOR_OUT_REPORT_SIZE
        int "Vendor output report packet size"
        range 7 64
        default 64

    config BT_CONNECT_KBD
        bool "Enable Bluetooth keyboard HID transport"
        default y

    config BT_CONNECT_MOUSE
        bool "Enable Bluetooth mouse HID transport"
        default y

    config BT_CONNECT_VENDOR
        bool "Enable Bluetooth vendor transport"
        default y
        select VENDOR_HID

    config BT_CONNECT_SPLIT_BAS
        bool "Enable secondary BAS for split keyboard slave battery"
        default y if SPLITLINK_SYNC_MASTER

    configdefault BT_MAX_CONN
        default 1

    configdefault BT_MAX_PAIRED
        default 2

    configdefault BT_ATT_TX_COUNT
        default 5

    configdefault BT_GATT_AUTO_SEC_REQ
        default n

    configdefault BT_AUTO_PHY_UPDATE
        default n

    configdefault BT_DEVICE_APPEARANCE
        default 961

    configdefault BT_GATT_UUID16_POOL_SIZE
        default 40

    configdefault BT_GATT_CHRC_POOL_SIZE
        default 20

    configdefault BT_HIDS_ATTR_MAX
        default 40

    configdefault BT_DIS_MANUF_NAME_STR
        default "YarmanKeyboards"

    configdefault BT_DIS_PNP_VID_SRC
        default 2

    configdefault BT_DIS_PNP_VID
        default 0x6969

    configdefault BT_HIDS_MAX_CLIENT_COUNT
        default 1

    choice BT_HIDS_DEFAULT_PERM
        default BT_HIDS_DEFAULT_PERM_RW_ENCRYPT
    endchoice

endif # BT_CONNECT
```

## subsys/kb_handler/Kconfig
```kconfig
menuconfig KB_HANDLER
    bool "Enable KB Handler subsystem"
    select KSCAN

if KB_HANDLER

    choice KB_HANDLER_IMPL
        prompt "KB Handler implementation"

        config KB_HANDLER_SPLITLINK_MASTER
            bool "Splitlink (master)"
            select SPLITLINK
            select SPLITLINK_SYNC
            select SPLITLINK_SYNC_MASTER

        config KB_HANDLER_SPLITLINK_SLAVE
            bool "Splitlink (slave)"
            select SPLITLINK
            select SPLITLINK_SYNC
            select SPLITLINK_SYNC_SLAVE

        config KB_HANDLER_SIMPLE
            bool "Simple"

    endchoice # KB_HANDLER_IMPL

    module = KB_HANDLER
    module-str = kb_handler
    source "subsys/logging/Kconfig.template.log_config"

    rsource "Kconfig.simple"

    config KB_HANDLER_INIT_PRIORITY
        int "Init priority"
        default APPLICATION_INIT_PRIORITY

    config KB_HANDLER_MSGQ_SIZE
        int "KB Handler message queue size"
        default 60

    config KB_HANDLER_THREAD_STACK_SIZE
        int "KB Handler thread stack size"
        default 3072

    config KB_HANDLER_THREAD_PRIORITY
        int "KB Handler thread priority"
        default 15

    config KB_HANDLER_REPORT_ROLLOVER
        bool "Enable rollover error when more than 6 keys are pressed at once"
        default y

endif
```

## subsys/kb_handler/Kconfig.splitlink
```kconfig
if KB_HANDLER_SPLITLINK

    choice KB_HANDLER_SPLITLINK_HANDLER_IMPL
        prompt "Splitlink driver handler"
        
        config KB_HANDLER_SPLITLINK_HANDLER_IMPL_YKB_PROTO
            bool "Splitlink driver handler over YKB protocol"

    endchoice

    if KB_HANDLER_SPLITLINK_HANDLER_IMPL_YKB_PROTO

        config KB_HANDLER_SL_OUT_OF_ORDER_TRACK
            bool "Enable out-of-order feature of YKB protocol"
            default y if SPLITLINK_BT
            default n

        config KB_HANDLER_SL_BITMAP_LENGTH
            int "Bitmap length for out-of-order feature"
            depends on KB_HANDLER_SL_OUT_OF_ORDER_TRACK
            default 32
            range 1 256

        config KB_HANDLER_SL_BENCHMARK
            bool "Enable Splitlink RTT benchmark"
            default n

        config KB_HANDLER_SL_BENCHMARK_INTERVAL_MS
            int "Splitlink RTT benchmark interval in ms"
            depends on KB_HANDLER_SL_BENCHMARK
            default 1000
            range 1 60000

        config KB_HANDLER_SL_BENCHMARK_PAYLOAD_SIZE
            int "Splitlink RTT benchmark payload size"
            depends on KB_HANDLER_SL_BENCHMARK
            default 16
            range 0 48

    endif # KB_HANDLER_SPLITLINK_HANDLER_IMPL_YKB_PROTO

endif # KB_HANDLER_SPLITLINK
```
