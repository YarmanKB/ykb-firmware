## subsys/ykb_backlight/Kconfig
```kconfig
ZEPHYR_USER := zephyr,user

menuconfig YKB_BACKLIGHT
    bool "Enable backlight subsystem for LED strip based backlight"
	depends on $(dt_node_has_prop,/$(ZEPHYR_USER),ykb-backlight)
    select LED_STRIP
    select LUMISCRIPT

if YKB_BACKLIGHT

    module = YKB_BACKLIGHT
    module-str = ykb_backlight
    source "subsys/logging/Kconfig.template.log_config"

    config YKB_BL_THREAD_STACK_SIZE
        int "Thread stack size"
        default 80000

    config YKB_BL_THREAD_PRIORITY
        int "Thread priority"
        default 15

    config YKB_BL_INIT_PRIORITY
        int "Init priority"
        default APPLICATION_INIT_PRIORITY

    menu "Lumiscript VM"

        config YKB_BL_SCRIPT_SLOT_COUNT
            int "Number of persistent Lumiscript slots"
            default 8

        config YKB_BL_SCRIPT_SLOT_SIZE
            int "Maximum bytecode size per persistent Lumiscript slot"
            default 1024

        config YKB_BL_SCRIPT_NAME_MAX_LEN
            int "Maximum Lumiscript slot name length"
            default 20

        config YKB_BL_LUMIVM_CONST_CAPACITY
            int "Lumiscript VM max amount of constants"
            default 512

        config YKB_BL_LUMIVM_GLOBAL_CAPACITY
            int "Lumiscript VM max amount of global variables"
            default 256

        config YKB_BL_LUMIVM_KEY_VAR_CAPACITY
            int "Lumiscript VM max amount of key variables"
            default 128

        config YKB_BL_LUMIVM_CODE_CAPACITY
            int "Lumiscript VM max size of the bytecode script"
            default 8192

        config YKB_BL_LUMIVM_STACK_CAPACITY
            int "Lumiscript VM max amount of stack objects"
            default 256

    endmenu

endif # YKB_BACKLIGHT
```

## subsys/ykb_battsense/Kconfig
```kconfig
ZEPHYR_USER := zephyr,user

menuconfig YKB_BATTSENSE
    bool "Enable YKB BattSense subsystem for monitoring battery events"
	depends on $(dt_node_has_prop,/$(ZEPHYR_USER),ykb-battsense-charger)
	depends on $(dt_node_has_prop,/$(ZEPHYR_USER),ykb-battsense-fuel-gauge)
    select CHARGER
    select FUEL_GAUGE

if YKB_BATTSENSE

    module = YKB_BATTSENSE
    module-str = ykb_battsense
    source "subsys/logging/Kconfig.template.log_config"

    config YKB_BATTSENSE_THREAD_DEFAULT_SLEEP_TIME
        int "Amount of milliseconds between battery readings"
        default 2000

    config YKB_BATTSENSE_CRIT_THRESHOLD
        int "Battery percentage (RSOC) considered 'critical'"
        default 1
        range 0 100

    config YKB_BATTSENSE_LOW_THRESHOLD
        int "Battery percentage (RSOC) considered 'low'"
        default 5
        range YKB_BATTSENSE_CRIT_THRESHOLD 100

    config YKB_BATTSENSE_PW_CUTOFF_PRESENT
        bool
        default y if $(dt_node_has_prop,/$(ZEPHYR_USER),ykb-battsense-pw-cutoff-gpios)

    config YKB_BATTSENSE_SHUTOFF_ON_CHARGER_FAILURE
        bool "Shutdown the system if charger failure detected"
        depends on YKB_BATTSENSE_PW_CUTOFF_PRESENT
        default y

    config YKB_BATTSENSE_INIT_PRIORITY
        int "BattSense initialization priority"
        default APPLICATION_INIT_PRIORITY

    config YKB_BATTSENSE_THREAD_PRIORITY
        int "BattSense thread priority"
        default 14

    config YKB_BATTSENSE_THREAD_STACK_SIZE
        int "BattSense thread stack size"
        default 1024

endif # YKB_BATTSENSE
```

## subsys/ykb_metrics/Kconfig
```kconfig
menuconfig YKB_METRICS
    bool "Enable YKB runtime metrics"
    default n
    select LOG
    help
      Collect lightweight runtime counters for kscan, keyboard handler, and
      HID report paths.

if YKB_METRICS

    module = YKB_METRICS
    module-str = ykb_metrics
    source "subsys/logging/Kconfig.template.log_config"

    config YKB_METRICS_KSCAN_UNIT_MAX
        int "Maximum tracked kscan scan units"
        default 12
        range 1 64
        help
          Number of distinct kscan device/unit pairs to track. A kscan-muxes
          device uses one unit per mux, kscan-channels uses one unit per ADC
          channel, and kscan-enables uses one unit for the device.

    config YKB_METRICS_LOG
        bool "Periodically log metrics"
        default y

    config YKB_METRICS_LOG_INTERVAL_MS
        int "Metrics log interval in ms"
        depends on YKB_METRICS_LOG
        default 1000
        range 100 60000

endif # YKB_METRICS
```

## subsys/ykb_power/Kconfig
```kconfig
menuconfig YKB_POWER
    bool "Enable YKB Power subsystem"
    select LED if YKB_POWER_INDICATOR_PRESENT
    select LED_PWM if YKB_POWER_INDICATOR_BRIGHTNESS_SUPPORT
    select LED_GPIO if YKB_POWER_INDICATOR_PRESENT && !YKB_POWER_INDICATOR_BRIGHTNESS_SUPPORT
    
if YKB_POWER

    module = YKB_POWER
    module-str = ykb_power
    source "subsys/logging/Kconfig.template.log_config"

    ZEPHYR_USER := zephyr,user

    config YKB_POWER_INDICATOR_PRESENT
        bool
        default y if $(dt_node_has_prop,/$(ZEPHYR_USER),ykb-power-indicator)

    YKB_POWER_INDICATOR := $(dt_node_ph_prop_path,/$(ZEPHYR_USER),ykb-power-indicator)
    YKB_POWER_INDICATOR_PARENT := $(dt_node_parent,$(YKB_POWER_INDICATOR))

    # Not sure if this is the best way, works for now,
    # since most likely it's just going to be
    # 'gpio-leds' or 'pwm-leds' on most boards
    config YKB_POWER_INDICATOR_BRIGHTNESS_SUPPORT
        bool
        depends on YKB_POWER_INDICATOR_PRESENT
        default n if $(dt_node_has_compat,$(YKB_POWER_INDICATOR_PARENT),gpio-leds)
        default y

    config YKB_POWER_BUTTON_PRESENT
        bool
        default y if $(dt_node_has_prop,/$(ZEPHYR_USER),ykb-power-button)

    config YKB_POWER_SHUTDOWN_GPIOS_PRESENT
        bool
        default y if $(dt_node_has_prop,/$(ZEPHYR_USER),ykb-power-shutdown-gpios)

    config YKB_POWER_INIT_PRIORITY
        int "YKB Power initialization priority"
        default APPLICATION_INIT_PRIORITY

    config YKB_POWER_THREAD_PRIORITY
        int "YKB Power thread priority"
        default 14

    config YKB_POWER_THREAD_STACK_SIZE
        int "YKB Power thread stack size"
        default 1024

    config YKB_POWER_THREAD_SLEEP_TIME
        int "Thread sleep time in milliseconds"
        default 3
        range 1 100

endif # YKB_POWER
```
