/dts-v1/;
#include <nordic/nrf5340_cpuapp_qkaa.dtsi>
#include "cpuapp/common.dts"

/ {
	model = "YKB Skadi Right board";
	compatible = "ykb,skadi-nrf5340-cpuapp-right";

	chosen {
		zephyr,sram = &sram0_image;
		zephyr,flash = &flash0;
		zephyr,code-partition = &slot0_partition;
		zephyr,sram-secure-partition = &sram0_s;
		zephyr,sram-non-secure-partition = &sram0_ns;
	};
};

&splitlink {
	compatible = "splitlink-bt-peripheral";
};
